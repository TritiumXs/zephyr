/*
 * Copyright (c) 2026 Lucy Wong
 *
 * SPDX-License-Identifier: Apache-2.0
 */

#include <wch/ch573/ch573.dtsi>
#include <mem.h>

/ {
	soc {
		/* CH573X: CodeFlash 448KB, RAM 18KB */
		flash0: flash@0 {
			reg = <0x00000000 DT_SIZE_K(448)>;
		};

		sram0: memory@20003800 {
			reg = <0x20003800 DT_SIZE_K(18)>;
		};
	};
};
