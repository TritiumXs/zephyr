## boards/wch/ch32v103evt/ch32v103evt_defconfig
```kconfig
# Copyright (c) 2024 Lucy Wong
# SPDX-License-Identifier: Apache-2.0

CONFIG_GPIO=y

CONFIG_SERIAL=y
CONFIG_CONSOLE=y
CONFIG_UART_CONSOLE=y
```

## boards/wch/ch573evt/Kconfig.ch573evt
```kconfig
# Copyright (c) 2026 Lucy Wong
# SPDX-License-Identifier: Apache-2.0

config BOARD_CH573EVT
	select SOC_CH573
```

## boards/wch/ch573evt/board.yml
```yaml
board:
  name: ch573evt
  full_name: WCH CH573EVT
  vendor: wch
  socs:
    - name: ch573
```

## boards/wch/ch573evt/ch573evt_defconfig
```kconfig
# Copyright (c) 2026 Lucy Wong
# SPDX-License-Identifier: Apache-2.0

CONFIG_SOC_CH573=y
CONFIG_BOARD_CH573EVT=y
CONFIG_SYS_CLOCK_HW_CYCLES_PER_SEC=60000000
```

## dts/bindings/clock/wch,ch573-rcc.yaml
```yaml
# Copyright (c) 2026 Lucy Wong
# SPDX-License-Identifier: Apache-2.0

description: WCH CH573 Reset and Clock Control

compatible: "wch,ch573-rcc"

include: [clock-controller.yaml, base.yaml]

properties:
  "#clock-cells":
    const: 1

clock-cells:
  - id
```

## soc/wch/ch32v/qingke_v3a/Kconfig
```kconfig
# Copyright (c) 2024 Lucy Wong
# SPDX-License-Identifier: Apache-2.0

config SOC_SERIES_QINGKE_V3A
```

## soc/wch/ch32v/qingke_v3a/Kconfig.defconfig.ch573
```kconfig
# Copyright (c) 2026 Lucy Wong
# SPDX-License-Identifier: Apache-2.0

if SOC_CH573

config VECTOR_TABLE_SIZE
	default 36

config NUM_IRQS
	default 36

endif # SOC_CH573
```

## soc/wch/ch32v/qingke_v3a/Kconfig.soc.ch573
```kconfig
# Copyright (c) 2026 Lucy Wong
# SPDX-License-Identifier: Apache-2.0

config SOC_CH573
	bool
	select SOC_SERIES_QINGKE_V3A

config SOC
	default "ch573" if SOC_CH573
```
